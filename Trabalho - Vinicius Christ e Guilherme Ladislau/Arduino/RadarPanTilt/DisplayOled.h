/*
 * SimpleOLED Library
 * Copyright (C) 2025 Jobit Joseph
 * Author: Jobit Joseph
 * Project: SimpleOLED Library
 *
 * Licensed under the MIT License
 * You may not use this file except in compliance with the License.
 *
 * You may obtain a copy of the License at:
 * https://opensource.org/license/mit/
 *
 * Permission is hereby granted, free of charge, to any person obtaining a copy
 * of this software (the "Software") and associated documentation files, to deal
 * in the Software without restriction, including without limitation the rights
 * to use, copy, modify, merge, publish, distribute, sublicense, and/or sell
 * copies of the Software, subject to the following additional conditions:

 * 1. All copies or substantial portions must retain:
 *    - The original copyright notice
 *    - A prominent statement crediting the original author/creator

 * 2. Modified versions must:
 *    - Clearly mark the changes as their own
 *    - Preserve all original credit notices
 *
 * THE SOFTWARE IS PROVIDED "AS IS", WITHOUT WARRANTY OF ANY KIND, EXPRESS OR
 * IMPLIED, INCLUDING BUT NOT LIMITED TO THE WARRANTIES OF MERCHANTABILITY,
 * FITNESS FOR A PARTICULAR PURPOSE AND NONINFRINGEMENT. IN NO EVENT SHALL THE
 * AUTHORS OR COPYRIGHT HOLDERS BE LIABLE FOR ANY CLAIM, DAMAGES OR OTHER
 * LIABILITY, WHETHER IN AN ACTION OF CONTRACT, TORT OR OTHERWISE, ARISING FROM,
 * OUT OF OR IN CONNECTION WITH THE SOFTWARE OR THE USE OR OTHER DEALINGS IN THE
 * SOFTWARE.
 */

#ifndef OLEDTEXTO_H
#define OLEDTEXTO_H

#include <Arduino.h>
#include <Wire.h>

#define OLED_ENDERECO 0x3C

static const byte OLED_FONTE[] PROGMEM = {
  0x00, 0x00, 0x00, 0x00, 0x00,
  0x00, 0x00, 0x5F, 0x00, 0x00,
  0x00, 0x07, 0x00, 0x07, 0x00,
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  0x02, 0x01, 0x02, 0x04, 0x02
};

static const byte OLED_INIT[] PROGMEM = {
  0xAE,
  0xD5, 0x80,
  0xA8, 0x3F,
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  0xA4, 0xA6,
  0xAF
};

static byte oledN;

static inline void oledCmd(byte c) {
  Wire.beginTransmission(OLED_ENDERECO);
  Wire.write((byte)0x00);
  Wire.write(c);
  Wire.endTransmission();
}

static inline void oledInicia() {
  for (byte i = 0; i < sizeof(OLED_INIT); i++) oledCmd(pgm_read_byte(&OLED_INIT[i]));
}

static inline void oledPos(byte col, byte pagina) {
  oledCmd(0x21); oledCmd(col); oledCmd(127);
  oledCmd(0x22); oledCmd(pagina); oledCmd(pagina);
}

static inline void oledAbre() {
  Wire.beginTransmission(OLED_ENDERECO);
  Wire.write((byte)0x40);
  oledN = 0;
}

static inline void oledByte(byte b) {
  if (oledN >= 30) {
    Wire.endTransmission();
    oledAbre();
  }
  Wire.write(b);
  oledN++;
}

static inline void oledFim() { Wire.endTransmission(); }

static inline void oledIni(byte col, byte pagina) {
  oledPos(col, pagina);
  oledAbre();
}

static inline void oledChar(char c) {
  if (c < 32 || c > 126) c = 32;
  const byte *p = &OLED_FONTE[(c - 32) * 5];
  for (byte i = 0; i < 5; i++) oledByte(pgm_read_byte(p + i));
  oledByte(0);
}

static inline byte oledEscP(const __FlashStringHelper* s) {
  PGM_P p = (PGM_P)s;
  byte n = 0;
  char c;
  while ((c = pgm_read_byte(p++))) { oledChar(c); n++; }
  return n;
}

static inline byte oledEsc(const char* s) {
  byte n = 0;
  while (*s) { oledChar(*s++); n++; }
  return n;
}

static inline byte oledEscNum(int v, byte largura) {
  char b[7];
  byte n = 0;
  unsigned int u = (v < 0) ? -v : v;
  do { b[n++] = '0' + u % 10; u /= 10; } while (u);
  if (v < 0) b[n++] = '-';
  byte total = n;
  for (byte i = n; i < largura; i++) { oledChar(' '); total++; }
  while (n) oledChar(b[--n]);
  return total;
}

static inline void oledLimpa() {
  for (byte pagina = 0; pagina < 8; pagina++) {
    oledIni(0, pagina);
    for (byte i = 0; i < 128; i++) oledByte(0);
    oledFim();
  }
}

#endif
