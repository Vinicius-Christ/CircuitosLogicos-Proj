/* 
 * SimpleOLED Library
 * Copyright (C) 2025 Jobit Joseph
 * Author: Jobit Joseph
 * Project: SimpleOLED Library
 *
 * Licensed under the MIT License
 * You may not use this file except in compliance with the License.
 * 
 * You may obtain a copy of the License at:
 * https://opensource.org/license/mit/
 * 
 * Permission is hereby granted, free of charge, to any person obtaining a copy
 * of this software (the "Software") and associated documentation files, to deal
 * in the Software without restriction, including without limitation the rights
 * to use, copy, modify, merge, publish, distribute, sublicense, and/or sell
 * copies of the Software, subject to the following additional conditions:

 * 1. All copies or substantial portions must retain:  
 *    - The original copyright notice  
 *    - A prominent statement crediting the original author/creator  

 * 2. Modified versions must:  
 *    - Clearly mark the changes as their own  
 *    - Preserve all original credit notices
 *
 * THE SOFTWARE IS PROVIDED "AS IS", WITHOUT WARRANTY OF ANY KIND, EXPRESS OR
 * IMPLIED, INCLUDING BUT NOT LIMITED TO THE WARRANTIES OF MERCHANTABILITY,
 * FITNESS FOR A PARTICULAR PURPOSE AND NONINFRINGEMENT. IN NO EVENT SHALL THE
 * AUTHORS OR COPYRIGHT HOLDERS BE LIABLE FOR ANY CLAIM, DAMAGES OR OTHER
 * LIABILITY, WHETHER IN AN ACTION OF CONTRACT, TORT OR OTHERWISE, ARISING FROM,
 * OUT OF OR IN CONNECTION WITH THE SOFTWARE OR THE USE OR OTHER DEALINGS IN THE
 * SOFTWARE.
 */

/*
 * OledTexto.h - driver minimo de TEXTO para OLED SSD1306 128x64 (I2C),
 * SEM buffer de tela.
 *
 * ALTERADO em relacao a biblioteca SimpleOLED acima (alteracoes marcadas como
 * nossas): a SimpleOLED guarda a tela inteira na RAM (1024 bytes, metade da RAM
 * do ATmega328P). Aqui o texto e enviado direto ao display, linha a linha, e so
 * o que muda e redesenhado. Foram reaproveitados da SimpleOLED a fonte 5x7 e a
 * sequencia de inicializacao do SSD1306.
 *
 * A tela tem 8 "paginas" (linhas de texto de 8 pixels) e 128 colunas (pixels).
 * Cada caractere ocupa 6 colunas (5 da fonte + 1 de espaco): 21 por linha.
 *
 * Uso:   oledIni(coluna, pagina);   // posiciona e abre a transmissao
 *        oledEscP(F("texto"));      // escreve texto guardado na flash
 *        oledEscNum(123, 5);        // escreve um inteiro alinhado a direita
 *        oledFim();                 // fecha a transmissao
 */
#ifndef OLEDTEXTO_H
#define OLEDTEXTO_H

#include <Arduino.h>
#include <Wire.h>

#define OLED_ENDERECO 0x3C

// Fonte 5x7, ASCII 32 a 126 (5 colunas por caractere). Origem: SimpleOLED.
static const byte OLED_FONTE[] PROGMEM = {
  0x00, 0x00, 0x00, 0x00, 0x00,  // Space
  0x00, 0x00, 0x5F, 0x00, 0x00,  // !
  0x00, 0x07, 0x00, 0x07, 0x00,  // "
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  0x02, 0x01, 0x02, 0x04, 0x02   // ~
};

// Sequencia de inicializacao do SSD1306 128x64. Origem: SimpleOLED::begin().
static const byte OLED_INIT[] PROGMEM = {
  0xAE,             // display desligado
  0xD5, 0x80,       // clock
  0xA8, 0x3F,       // multiplex: 64 linhas
  0xD3, 0x00,       // deslocamento
  0x40,             // linha inicial
  0x8D, 0x14,       // charge pump
  0x20, 0x00,       // enderecamento horizontal
  0xA1,             // remapeia colunas
  0xC8,             // varredura das linhas
  0xDA, 0x12,       // pinos COM
  0x81, 0xCF,       // contraste
  0xD9, 0xF1,       // pre-carga
  0xDB, 0x40,       // VCOM
  0xA4, 0xA6,       // mostra a RAM do display, sem inverter
  0xAF              // display ligado
};

static byte oledN;  // bytes de dados na transmissao aberta (o buffer do Wire tem 32)

static inline void oledCmd(byte c) {
  Wire.beginTransmission(OLED_ENDERECO);
  Wire.write((byte)0x00);
  Wire.write(c);
  Wire.endTransmission();
}

// Liga o OLED. Chame depois de Wire.begin().
static inline void oledInicia() {
  for (byte i = 0; i < sizeof(OLED_INIT); i++) oledCmd(pgm_read_byte(&OLED_INIT[i]));
}

// Posiciona o cursor: col em pixels (0 a 127), pagina = linha de texto (0 a 7).
static inline void oledPos(byte col, byte pagina) {
  oledCmd(0x21); oledCmd(col); oledCmd(127);
  oledCmd(0x22); oledCmd(pagina); oledCmd(pagina);
}

static inline void oledAbre() {
  Wire.beginTransmission(OLED_ENDERECO);
  Wire.write((byte)0x40);
  oledN = 0;
}

static inline void oledByte(byte b) {
  if (oledN >= 30) {            // buffer do Wire cheio: fecha e abre outra transmissao
    Wire.endTransmission();
    oledAbre();
  }
  Wire.write(b);
  oledN++;
}

static inline void oledFim() { Wire.endTransmission(); }

// Posiciona e abre a transmissao (use junto com oledFim).
static inline void oledIni(byte col, byte pagina) {
  oledPos(col, pagina);
  oledAbre();
}

// Escreve um caractere (6 colunas). Use entre oledIni() e oledFim().
static inline void oledChar(char c) {
  if (c < 32 || c > 126) c = 32;
  const byte *p = &OLED_FONTE[(c - 32) * 5];
  for (byte i = 0; i < 5; i++) oledByte(pgm_read_byte(p + i));
  oledByte(0);
}

// Texto guardado na flash, F("..."). Devolve quantos caracteres escreveu.
static inline byte oledEscP(const __FlashStringHelper* s) {
  PGM_P p = (PGM_P)s;
  byte n = 0;
  char c;
  while ((c = pgm_read_byte(p++))) { oledChar(c); n++; }
  return n;
}

// Texto da RAM. Devolve quantos caracteres escreveu.
static inline byte oledEsc(const char* s) {
  byte n = 0;
  while (*s) { oledChar(*s++); n++; }
  return n;
}

// Inteiro alinhado a direita, com espacos a esquerda ate completar `largura`
// (largura 0 = sem preenchimento). Devolve quantos caracteres escreveu.
static inline byte oledEscNum(int v, byte largura) {
  char b[7];
  byte n = 0;
  unsigned int u = (v < 0) ? -v : v;
  do { b[n++] = '0' + u % 10; u /= 10; } while (u);
  if (v < 0) b[n++] = '-';
  byte total = n;
  for (byte i = n; i < largura; i++) { oledChar(' '); total++; }
  while (n) oledChar(b[--n]);
  return total;
}

// Apaga a tela toda.
static inline void oledLimpa() {
  for (byte pagina = 0; pagina < 8; pagina++) {
    oledIni(0, pagina);
    for (byte i = 0; i < 128; i++) oledByte(0);
    oledFim();
  }
}

#endif
